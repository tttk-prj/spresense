## examples/lcd_test/Kconfig
```kconfig
config EXAMPLES_LCD_TEST
	bool "Test driver of ACM0802C-NLW-BBW-IIC"
	default n
	---help---
		Enable the lcd_test app

if EXAMPLES_LCD_TEST

config EXAMPLES_LCD_TEST_PROGNAME
	string "Program name"
	default "lcd_test"
	depends on BUILD_KERNEL
	---help---
		This is the name of the program that will be use when the NSH ELF
		program is installed.

config EXAMPLES_LCD_TEST_PRIORITY
	int "lcd_test task priority"
	default 100

config EXAMPLES_LCD_TEST_STACKSIZE
	int "lcd_test stack size"
	default 2048

config EXAMPLES_LCD_TEST_USE_HW_IIC
	bool "Use Spresense HW IIC peripheral"
	default n
	---help---
		Use Spresense HW IIC Peripheral device to comunicate with LCD device.
		If it is set n, SW emulates IIC on I2C0 port.

endif
```

## examples/nes/Kconfig
```kconfig
config EXAMPLES_NES
	bool "NES emulator by using Cycloa"
	default n
	---help---
		Enable the nes app

if EXAMPLES_NES

config EXAMPLES_NES_PROGNAME
	string "Program name"
	default "nes"
	depends on BUILD_KERNEL
	---help---
		This is the name of the program that will be use when the NSH ELF
		program is installed.

config EXAMPLES_NES_PRIORITY
	int "nes task priority"
	default 100

config EXAMPLES_NES_STACKSIZE
	int "nes stack size"
	default 2048

endif
```

## sdk/configs/nes-defconfig
```kconfig
CONFIG_SDK_USER_ENTRYPOINT="spresense_main"
CONFIG_CXD56_SDIO=y
CONFIG_CXD56_EMMC=y
CONFIG_CXD56_SPI=y
CONFIG_CXD56_SPI3=y
CONFIG_CXD56_SPI5=y
CONFIG_CXD56_I2C=y
CONFIG_CXD56_I2C0=y
# CONFIG_CXD56_SCU is not set
CONFIG_LCD=y
CONFIG_LCD_ILI9340=y
CONFIG_LCD_ILI9340_IFACE0=y
CONFIG_LCD_ILI9340_IFACE0_RLANDSCAPE=y
CONFIG_ASMP=y
CONFIG_NSH_ROMFSETC=y
CONFIG_NSH_CUSTOMROMFS=y
CONFIG_NSH_CUSTOMROMFS_HEADER="../../examples/nes/boot_script/nsh_romfsimg.h"
CONFIG_EXAMPLES_NES=y
```
